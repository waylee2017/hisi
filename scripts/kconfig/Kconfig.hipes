## scripts/kconfig/Kconfig.uboot
```kconfig
#+++++++++++++++++++++++++++++++++++++++++++++++++++
choice
	prompt "Boot Type"
	default HI_UBOOT_SUPPORT

config  HI_UBOOT_SUPPORT
	bool "fastboot"
config  HI_MINIBOOT_SUPPORT
	bool "miniboot"
endchoice

config  HI_BOOT_LOGOUT_DISABLE
	bool "Disable Boot Log Output"
	default n
	depends on HI_MINIBOOT_SUPPORT
	help
	  select to disable print in miniboot.
	  
menuconfig HI_FORCE_ENV_TO_MEDIA
	bool "Force Environment variables to specific flash media"
	default n
	depends on HI_UBOOT_SUPPORT
	help
	  This option enables forcing environment variables to Nand/SPI Flash.
	  if not enabled, the environment variables are saved to the boot media, that is to say,
	  if the boot is burnt to SPI Flash, the environment variables are saved to SPI Flash.
	  Medias for choosing: such as SPI Flash, Nand Flash, etc.

source "scripts/kconfig/Kconfig.env.media"

config HI_BOOT_ENV_STARTADDR
	hex "Environment Variables Partition Start Address"
	default 0x80000
	help
	  Start address of the partition you want to save environment variables.

config HI_BOOT_ENV_SIZE
	hex "Environment Variables Image Size"
	default 0x2000
	help
	  Size of environment variables image.
config HI_BOOT_ENV_RANGE
	hex "Environment Variables Partition Read/Write Range"
	default HI_BOOT_ENV_SIZE
	help
	  When read/write environment variables,if there are bad blocks,
	  this indicates the size driver should skip.Default value set to 
	  be the size of environment variables partition size, usually one
	  block.Only useful for nand.

config HI_BOOT_ENV_BAK_SUPPORT
	bool "Backup Environment support"
	default y
	help
	  The backup Environment support. When read and check Environment failed,
	  we should try backup Envioronment.

config HI_BOOT_ENV_STARTADDR_BAKUP
	hex "Backup environment Variables Partition Start Address"
	depends on HI_BOOT_ENV_BAK_SUPPORT
	default HI_BOOT_ENV_STARTADDR
	help
	  Start address of the partition you want to save your BACKUP environment variables.

config HI_BOOT_COMPRESSED
        bool "Build Compressed Fastboot Image"
        default n
        help
          Say y here if you want to build compressed fastboot image. The compressed
          fastboot image is smaller.

config HI_BOOT_USB_SUPPORT
	bool "Support Usb Drivers"
	default n 
	select HI_BOOT_FAT_SUPPORT
	help
	  Say y here if you want to support usb for boot.

config HI_BOOT_FAT_SUPPORT
	bool "Support FAT filesystem"
	depends on HI_BOOT_USB_SUPPORT
	default y
	help
	  Say y here if you want fat filesystem support for boot.
	  Support read file, not support write file.

config HI_BOOT_USB2ETHER
	bool "Support USB2ETH"
	depends on HI_BOOT_USB_SUPPORT
	default n
	help
	  Say y here if you want support usb2eth.
	  Support ASIX8872/mcs7830/smsc95xx for now.

menu "Build Product Code in Fastboot"
config HI_BUILD_WITH_PRODUCT
	bool "Build Product Code in Fastboot"
	default n
	help
	  This option enables you to build product directory in fastboot. Final
	  fastboot-burn.bin contains product. If you set to n here, product
	  will not build with fastboot, there will generate another bin file,
	  which can be run up by "bootapp (addr)" cmd.

source "scripts/kconfig/Kconfig.bootloader"

menuconfig HI_BUILD_WITH_FRONTEND
       bool "Build Frontend Code in Fastboot"
       depends on HI_BUILD_WITH_PRODUCT && (HI_TUNER_DEV_TYPE_ALPS_TDAE || HI_TUNER_DEV_TYPE_TDCC || HI_TUNER_DEV_TYPE_TDA18250 || HI_TUNER_DEV_TYPE_TDA18250B || HI_TUNER_DEV_TYPE_TMX7070X || HI_TUNER_DEV_TYPE_R820C || HI_TUNER_DEV_TYPE_R836 || HI_TUNER_DEV_TYPE_MXL203 || HI_TUNER_DEV_TYPE_AV2011 || HI_TUNER_DEV_TYPE_SHARP7903 || HI_TUNER_DEV_TYPE_M88TS2022 || HI_TUNER_DEV_TYPE_RDA5815 || HI_TUNER_DEV_TYPE_MXL603|| HI_TUNER_DEV_TYPE_MXL608)
       default y

config HI_BOOT_DISEQC_SUPPORT
	depends on HI_BUILD_WITH_FRONTEND && HI_TUNER_SIGNAL_SAT
	bool "DISEQC Support"
	default n
choice
	prompt "Tuner Used in Fastboot"
	depends on HI_BUILD_WITH_FRONTEND

config  HI_BOOT_TUNER_TYPE_ALPS_TDAE
	depends on HI_TUNER_DEV_TYPE_ALPS_TDAE
	bool "ALPS_TDAE Support"

config  HI_BOOT_TUNER_TYPE_TDCC
	depends on HI_TUNER_DEV_TYPE_TDCC
	bool "TDCC Support"

config  HI_BOOT_TUNER_TYPE_TDA18250
	depends on HI_TUNER_DEV_TYPE_TDA18250
	bool "TDA18250 Support"
config  HI_BOOT_TUNER_TYPE_TDA18250B
	depends on HI_TUNER_DEV_TYPE_TDA18250B
	bool "TDA18250B Support"
	
config  HI_BOOT_TUNER_TYPE_TMX7070X
	depends on HI_TUNER_DEV_TYPE_TMX7070X
	bool "TMX7070X Support"
	
config  HI_BOOT_TUNER_TYPE_R820C
	depends on HI_TUNER_DEV_TYPE_R820C
	bool "R820C Support"
	
config  HI_BOOT_TUNER_TYPE_R836
	depends on HI_TUNER_DEV_TYPE_R836
	bool "R836 Support"
			
config  HI_BOOT_TUNER_TYPE_MXL203
	depends on HI_TUNER_DEV_TYPE_MXL203
	bool "MXL203 Support"

config  HI_BOOT_TUNER_TYPE_AV2011
	depends on HI_TUNER_DEV_TYPE_AV2011
	bool "AV2011 Support"

config  HI_BOOT_TUNER_TYPE_SHARP7903
	depends on HI_TUNER_DEV_TYPE_SHARP7903
	bool "SHARP7903 Support"

config  HI_BOOT_TUNER_TYPE_M88TS2022
	depends on HI_TUNER_DEV_TYPE_M88TS2022
	bool "M88TS2022 Support"

config  HI_BOOT_TUNER_TYPE_RDA5815
	depends on HI_TUNER_DEV_TYPE_RDA5815
	bool "RDA5815 Support"

config  HI_BOOT_TUNER_TYPE_MXL603
	depends on HI_TUNER_DEV_TYPE_MXL603
	bool "MXL603 Support"
	
config  HI_BOOT_TUNER_TYPE_MXL608
	depends on HI_TUNER_DEV_TYPE_MXL608
	bool "MXL608 Support"
	
config  HI_BOOT_TUNER_TYPE_TDA18215
	depends on HI_TUNER_DEV_TYPE_TDA18215
	bool "TDA18215 Support"	
	
config  HI_BOOT_TUNER_TYPE_M88TC3800
	depends on HI_TUNER_DEV_TYPE_M88TC3800
	bool "M88TC3800 Support"
	
config  HI_BOOT_TUNER_TYPE_SI2144
	depends on HI_TUNER_DEV_TYPE_SI2144
	bool "SI2144 Support"	
		
config  HI_BOOT_TUNER_TYPE_TDA18275A
	depends on HI_TUNER_DEV_TYPE_TDA18275A
	bool "TDA18275A Support"	

config  HI_BOOT_TUNER_TYPE_MXL661
	depends on HI_TUNER_DEV_TYPE_MXL661
	bool "MXL661 Support"	

config  HI_BOOT_TUNER_TYPE_SI2150
	depends on HI_TUNER_DEV_TYPE_SI2150
	bool "SI2150 Support"	
	
config  HI_BOOT_TUNER_TYPE_R850
	depends on HI_TUNER_DEV_TYPE_R850
	bool "R850 Support"
	
endchoice

choice
	prompt "Demod Used in Fastboot"
	depends on HI_BUILD_WITH_FRONTEND

config  HI_BOOT_DEMOD_TYPE_HI3130I
	depends on HI_DEMOD_DEV_TYPE_3130I
	bool "HI3130I Support"
	
config  HI_BOOT_DEMOD_TYPE_J83B
	depends on HI_DEMOD_DEV_TYPE_J83B
	bool "J83B Support"
	
config  HI_BOOT_DEMOD_TYPE_HI3136
	depends on HI_DEMOD_DEV_TYPE_3136
	bool "HI3136 Support"
endchoice

menu    "LNB Chip Used in Fastboot"
	depends on HI_BUILD_WITH_FRONTEND && HI_TUNER_SIGNAL_SAT
config  HI_BOOT_LNB_CTRL_ISL9492
	depends on HI_BUILD_WITH_FRONTEND
        bool "ISL9492 Support"
        default n

config  HI_BOOT_LNB_CTRL_MPS8125
	depends on HI_BUILD_WITH_FRONTEND
        bool "MPS8125 Support"
        default n
endmenu

config  HI_BUILD_WITH_IR
        bool "Build IR in Fastboot"
        depends on HI_BUILD_WITH_PRODUCT
        default n

menuconfig HI_BUILD_WITH_KEYLED
        bool "Build Keyled in Fastboot"
        depends on HI_BUILD_WITH_PRODUCT && (HI_KEYLED_GPIOKEY_SUPPORT || HI_KEYLED_CT1642_SUPPORT || HI_KEYLED_PT6961_SUPPORT || HI_KEYLED_PT6964_SUPPORT || HI_KEYLED_FD650_SUPPORT)
        default y
choice
	prompt "Keyled Device Used in Fastboot"
	depends on HI_BUILD_WITH_KEYLED 
	default HI_BOOT_KEYLED_PT6964
config  HI_BOOT_KEYLED_GPIOKEY
	bool "Gpiokey Keyled"
	depends on HI_KEYLED_GPIOKEY_SUPPORT
config  HI_BOOT_KEYLED_74HC164
	bool "74HC164 Keyled"
	depends on HI_KEYLED_74HC164_SUPPORT
config  HI_BOOT_KEYLED_CT1642
	bool "Ct1642 Keyled"
	depends on HI_KEYLED_CT1642_SUPPORT
config  HI_BOOT_KEYLED_PT6961
	bool "Pt6961 Keyled"
	depends on HI_KEYLED_PT6961_SUPPORT 
config  HI_BOOT_KEYLED_PT6964
	bool "Pt6964 Keyled"
	depends on HI_KEYLED_PT6964_SUPPORT
config  HI_BOOT_KEYLED_FD650
	bool "Fd650 Keyled"
	depends on HI_KEYLED_FD650_SUPPORT
endchoice

endmenu
```

## scripts/kconfig/Kconfig.vdec
```kconfig
#+++++++++++++++++++++++++++++++++++++++++++++++++++
menu "Video Decoder Config"

#+++++++++++++++++++++++++++++++++++++++++++++++++++
choice
	prompt "VFMW Decode Capability"
	default HD_FULL 

config  HD_FULL
	bool "All Support" 
	depends on !HI3110EV500
	help
		All Support.
config  HD_SIMPLE
	bool "H264,MPEG2,MPEG4 Only"
	help
		H264,MPEG2,MPEG4 Support.
config HD_BASIC
    bool "H264,MPEG2,MPEG4,AVS,AVS+ Only"
    help 
        H264,MPEG2,MPEG4,AVS,AVS+ Support.
endchoice

config  HI_VFMW_DECODE_CAPABILITY
	string 
	default "HD_FULL"             if HD_FULL
	default "HD_SIMPLE"           if HD_SIMPLE
	default "HD_BASIC"            if HD_BASIC

choice
	prompt "VFMW_DECODE_PREALLOC_MMZ"
	default FHD if !HI3110EV500
	default D1  if HI3110EV500 

config  FHD
	bool "FHD"
	depends on !HI3110EV500
	help
		PREALLOC MMZ According to FHD resolution ratio.
		
config  D1
	bool "D1 "
	help
		PREALLOC MMZ According to D1 resolution ratio.
		
endchoice

config  HI_VFMW_DECODE_PREALLOC_MMZ
	string 
	default "D1"             if D1
	default "FHD"           if FHD
	
#+++++++++++++++++++++++++++++++++++++++++++++++++++
config  HI_VDEC_MAX_INSTANCE
	int "Video Decoder Max Instance Number(1~16)"
	range 1 16
	default 1 if !HI_MCE_SUPPORT
        default 2 if HI_MCE_SUPPORT
	help
		It is necessarily set to bigger than 1 to support mce-fastpaly.

config  HI_VDEC_MAX_REF_FRAME
	int "Max Reference Frame Number(4~10)"
	range 4 10
	help
		Larger number means better compatibility. Recommend 7, at least 4.
	default 7
	
config  HI_VDEC_MAX_DISP_FRAME
	int "Max Display Frame Number(3~12)"
	range 3 12
	help
		Larger number means better effect. Recommend 8, at least 3.
	default 8
	
config  HI_VDEC_SCD_BUFFER_SIZE
	hex "SCD Buffer Size(0xa0000~0x500000)"
	range 0xa0000 0x500000
	help
		SCD buffer. Recommend 0x200000.
	default 0x200000

config  HI_VDEC_DEINTERLACE_SUPPORT
	bool "Deinterlace Support"
	help
		Open deinterlace function, if you have enough memory, say y.
	default y

config  HI_VDEC_SVDEC_SUPPORT
	bool "Soft Video Decode(hi_svdec.ko) Support"
	help
		If you want to support H263, say y;
	default y

config  HI_VDEC_REG_CODEC_SUPPORT
	bool "External Video Codec Register Support"
	help
		If you want to use API "HI_UNF_AVPLAY_RegisterVcodecLib()", say y.
	default n
	
config  HI_VDEC_MJPEG_SUPPORT
	bool "Motion JPEG Decoder Support"
	help
		If you want to use decode Motion JPEG stream, say y.
	default y
	
config  HI_VDEC_USERDATA_CC_SUPPORT
	bool "Closed Caption User Data Support"
	help
		If you want to receive closed caption user data, say y.
	default n
	
config  HI_VDEC_USERDATA_CC_BUFSIZE
	hex "Closed Caption User Data Buffer Size(0x4000~0x40000)"
	depends on HI_VDEC_USERDATA_CC_SUPPORT
	range 0x4000 0x40000
	help
		Closed caption user data buffer size. Recommend 0xC000.
	default 0xC000

config  HI_VDEC_DSD_SUPPORT
	bool "Dynamic Switch DNR Support"
	help
		If you want to Dynamic Switch DNR, say y.
	default n

endmenu
#+++++++++++++++++++++++++++++++++++++++++++++++++++
```

## scripts/kconfig/Kconfig.vo
```kconfig
#+++++++++++++++++++++++++++++++++++++++++++++++++++
menu "VO Config"

choice
	prompt "CVBS Circuit Type"
	default HI_DISP_CVBS_VIDEO_BUFF
	
config	HI_DISP_CVBS_VIDEO_BUFF
	bool "CVBS Video Buffer Type"
	
config	HI_DISP_CVBS_LC
	bool "CVBS LC Type"
endchoice

choice
	prompt "YPbPr Circuit Type"
	default HI_DISP_YPBPR_LC
	depends on !HI3110EV500
	
config	HI_DISP_YPBPR_VIDEO_BUFF
	bool "YPbPr Video Buffer Type"
	
config	HI_DISP_YPBPR_LC
	bool "YPbPr LC Type"
endchoice

config	HI_DISP_TTX_SUPPORT
	bool "SD TTX Out Support"
	depends on !HI3716MV330
	help
	  If you want enable VBI teletext , say y.
	default y
	
config	HI_DISP_TTX_INBUFFERSIZE
	hex "TTX Input Buffer Size"
	depends on HI_DISP_TTX_SUPPORT
	help 
	  You can adjust teletext input buffer size if you need.
	default 0x4000

config	HI_DISP_CC_SUPPORT
	bool "SD CC Output Support"
	depends on !HI3716MV330
	help
	  If you want enable VBI Closed Caption transfer, say y.
	default y

config	HI_DISP_CC_INBUFFERSIZE
	hex "SD CC Input Buffer Size"
	depends on HI_DISP_CC_SUPPORT
	help 
	  You can adjust Closed Caption input buffer size if you need.
	default 0x4000

config	HI_VO_DUMPFRAME_SUPPORT
	bool "Dump From VO For Debuging"
	help 
	  If you want to dump video frame from VO when debuging, say y.
	default n

endmenu
#+++++++++++++++++++++++++++++++++++++++++++++++++++
```

## scripts/kconfig/Kconfig.wifi
```kconfig
#+++++++++++++++++++++++++++++++++++++++++++++++++++
#--------------------------------
menuconfig HI_WIFI_SUPPORT
	bool "WiFi Support"
	default n
	help
	  This section contains all the supported 802.11 wireless device drivers.
	  Set to 'y' to support this device, 'n' not support.

menu    "WiFi Device Type"
	depends on HI_WIFI_SUPPORT

config  HI_WIFI_DEVICE_RTL8188EUS
	bool "Realtek RTL8188ETV and RTL8188EUS (11n 1x1 2.4G USB)"
config  HI_WIFI_DEVICE_RTL8192EU
	bool "Realtek RTL8192EU (11n 2x2 2.4G USB)"
config  HI_WIFI_DEVICE_RTL8723BU
        bool "Realtek RTL8723BU (11n 1x1 2.4G WiFi+BT USB)"
config  HI_WIFI_DEVICE_RT5370
	bool "Mediatek RT5370 (11n 1x1 2.4G USB)"
config  HI_WIFI_DEVICE_MT7601U
	bool "Mediatek MT7601U (11n 1x1 2.4G USB)"
config  HI_WIFI_DEVICE_RT5572
	bool "Mediatek RT5572 (11n 2x2 2.4G+5G USB)"
endmenu

menu	"WiFi Working Mode"
	depends on HI_WIFI_SUPPORT

config  HI_WIFI_MODE_STA
	bool "STA Mode"
config  HI_WIFI_MODE_AP
	bool "SoftAP Mode"
endmenu
```

## source/kernel/linux-3.10.y.patch/arch/arm/mach-hi3716mv310/Kconfig
```kconfig
if ARCH_HI3716MV310
menu "HI3716MV310 board feature"

config MACH_HI3716MV310
	bool "Support hi3716mv310 platform"
	select CPU_V7
	select ARM_GIC
	select ARM_TIMER_SP804
	help
	  Include support for the hisilion hi3716mv310 platform.

choice
	prompt "CPU Chip Type"
	default HI3716MV310
config  HI3716MV310
	bool "hi3716mv310"
endchoice

choice
	prompt "CPU timer source"
	default HAVE_ARM_LOCAL_TIMER_HI3716MV310

config HAVE_ARM_LOCAL_TIMER_HI3716MV310
	bool "arm local timer from arm self"
	help
	  arm local timer from arm self.
endchoice
config HI_HI3716MV310_HZ
	int "Config HZ"
	default 100 if HIGH_RES_TIMERS
	default 100

config DEFAULT_BUSCLK
	int "DEFAULT_BUSCLK"
	default "50000000"
	help
	  Default AHB clock rate

config DEFAULT_UART_BASE_ADDR
	hex "Default uart controller base address"
	default "0x101E5000"
	help
	  Default UART controller base address

config MMZ_PARAM
	string "MMZ param for CMA and ION"
	depends on CMA
	default "ddr,0,0,320M" if MACH_HI3716MV310
	help
	  This is the parameter of mmz memory manager, which now is for CMA 
	  and ION memory manager.

config HI3716MV310_FPGA
	bool "Enable HI3716MV310 Fpga config"

menuconfig SUPPORT_CA
	bool "Support CA"
	default n
	help
	  If support ca, user privileges will be limit.
	  select y, support ca, otherwise not support ca.

config CA_SUPPORT_ADVCA
	bool "Support advca"
	depends on SUPPORT_CA
	default n
	help
	  support advca, which is the real CA.

endmenu
endif
```
