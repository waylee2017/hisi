## scripts/kconfig/Kconfig.hipes
```kconfig
#+++++++++++++++++++++++++++++++++++++++++++++++++++
# menu "HIPES Config"
#+++++++++++++++++++++++++++++++++++++++++++++++++++

config HI_PES_SUPPORT
	bool "HIPES Support"
	default n

#+++++++++++++++++++++++++++++++++++++++++++++++++++
# endmenu
#+++++++++++++++++++++++++++++++++++++++++++++++++++
```

## scripts/kconfig/Kconfig.hiplayer
```kconfig
#+++++++++++++++++++++++++++++++++++++++++++++++++++
menuconfig HI_PLAYER_SUPPORT
	depends on HI_CAPTION_SUBT_SUPPORT && HI_CAPTION_SO_SUPPORT
	bool "HiPlayer Support"
	default y

#------------------------------------------------
choice
	prompt "HiPlayer Version"
	depends on HI_PLAYER_SUPPORT	
	default HI_PLAYER_FULL_SUPPORT
config  HI_PLAYER_FULL_SUPPORT
	bool "HiPlayer Full Support"	
config  HI_PLAYER_NORMAL_SUPPORT
	bool "HiPlayer Normal Support"		
endchoice
```

## scripts/kconfig/Kconfig.i2c
```kconfig
#++++++++++++++++++++++++++++++++++++++++++++++++++
menu "I2C Config"
#--------------------------------
config  HI_I2C_FIFO_SUPPORT
	bool "I2C FIFO Support"
	depends on HI3716MV330
	default n

endmenu
#+++++++++++++++++++++++++++++++++++++++++++++++++++
```

## scripts/kconfig/Kconfig.kernel
```kconfig
#+++++++++++++++++++++++++++++++++++++++++++++++++++
choice
	prompt "Kernel Version"
	default LINUX-3.10.y
config  LINUX-3.10.y
	bool "linux-3.10.y"
config  LINUX-4.4.y
    bool "linux-4.4.y"
endchoice

config  HI_KERNEL_VERSION
	string
	default linux-3.10.y if LINUX-3.10.y
	default linux-4.4.y if LINUX-4.4.y

config  HI_KERNEL_CFG
	prompt "Kernel Config File"
	string
	default hi3716mv310_defconfig if HI3716M
	help
	  Input config file for kernel. Such as xxxxx_defconfig.
	  Config files are located in kernel source: arch/arm/configs.

#---------------------------------------------
config  HI_FS_BUILDIN
	bool "Build Rootbox in Kernel"
	default n
	help
	  Say y to build rootbox in kernel.
#---------------------------------------------
config  HI_MSP_BUILDIN
	bool "Build MSP in Kernel"
	default n
	help
	  Say y to build MSP modules in kernel.	

#+++++++++++++++++++++++++++++++++++++++++++++++++++
```

## scripts/kconfig/Kconfig.loader
```kconfig
#+++++++++++++++++++++++++++++++++++++++++++++++++++
menuconfig  HI_LOADER_SUPPORT
	bool "HiLoader Support"
	depends on HI_BUILD_WITH_PRODUCT
	default y

#------------------------------------------------
#menu	"HiLoader Config"
#	depends on HI_LOADER_SUPPORT
	
choice
	prompt "Loader Type"
	default HI_LOADER_BOOTLOADER
	depends on HI_LOADER_SUPPORT	
config  HI_LOADER_BOOTLOADER
	bool "BootLoader"
config  HI_LOADER_APPLOADER
	bool "AppLoader"
endchoice
	
#------------------------------------------------
config  HI_LOADER_BACKUP_SUPPORT
	bool "Loader Backup Support"
	default y
	depends on (HI_LOADER_APPLOADER && HI_LOADER_SUPPORT)

#------------------------------------------------
config  HI_LOADER_MODE_USB
	bool "USB Upgrade Support"
	default y
	depends on HI_LOADER_SUPPORT

#------------------------------------------------
choice
        prompt "Protocol Type"
        default HI_LOADER_USB_PROTOCOL_HISI_FILE
        depends on HI_LOADER_MODE_USB
config  HI_LOADER_USB_PROTOCOL_HISI_FILE
        bool "Hisi File Protocol"
endchoice
#------------------------------------------------
config  HI_LOADER_MODE_IP
	bool "IP Upgrade Support"
	default y
	depends on (HI_LOADER_APPLOADER && HI_LOADER_SUPPORT)	
#------------------------------------------------
choice
        prompt "Protocol Type"
        default HI_LOADER_IP_PROTOCOL_HISI_FILE
        depends on HI_LOADER_MODE_IP
config  HI_LOADER_IP_PROTOCOL_HISI_FILE
        bool "Hisi File Protocol"
endchoice
#------------------------------------------------
config  HI_LOADER_MODE_OTA
	bool "OTA Upgrade Support"
	default y
	depends on HI_LOADER_SUPPORT

#------------------------------------------------
choice
	prompt "Tuner Type"
	default HI_LOADER_TUNER_CAB
	depends on HI_LOADER_MODE_OTA
config  HI_LOADER_TUNER_CAB
	bool "Cable"
config  HI_LOADER_TUNER_TER
	bool "Terrestrial"
config  HI_LOADER_TUNER_SAT
	bool "Satellite"
endchoice

#------------------------------------------------
choice
	prompt "Protocol Type"
	default HI_LOADER_PROTOCOL_HISI_OTA
	depends on HI_LOADER_MODE_OTA
config  HI_LOADER_PROTOCOL_SSU_OTA
	bool "SSU Protocol"
config  HI_LOADER_PROTOCOL_HISI_OTA
	bool "Hisi OTA Protocol"
endchoice


#------------------------------------------------
#endmenu
#+++++++++++++++++++++++++++++++++++++++++++++++++++
```

## scripts/kconfig/Kconfig.mce
```kconfig
  config  HI_MCE_SUPPORT
		bool "MCE Support"
		depends on HI_MSP_BUILDIN
		default n

	help
		HI_ADEC_MAX_INSTANCE and HI_VDEC_MAX_INSTANCE must be set to bigger than 1 to support smooth transition.
```

## scripts/kconfig/Kconfig.ntfs
```kconfig
#+++++++++++++++++++++++++++++++++++++++++++++++++++
menuconfig HI_NTFS_SUPPORT
	bool "NTFS Support"
	default n
config  HI_NTFS_MODULE_SUPPORT
	bool "NTFS Module Support"
	depends on HI_NTFS_SUPPORT
	default n
config  HI_NTFS_TOOLS_SUPPORT
	bool "NTFS Tools Support"
	depends on HI_NTFS_SUPPORT
	default n
config  HI_NTFS_CHECK_TOOLS_SUPPORT
	bool "NTFS Check Tools Support"
	depends on HI_NTFS_TOOLS_SUPPORT 
	default n
config  HI_NTFS_FORMAT_TOOLS_SUPPORT
	bool "NTFS Format Tools Support"
	depends on HI_NTFS_TOOLS_SUPPORT
	default n
#+++++++++++++++++++++++++++++++++++++++++++++++++++
```

## scripts/kconfig/Kconfig.pvr
```kconfig
menu "PVR Config"
config HI_PVR_SUPPORT
	bool "PVR Support"
	default y
config HI_PVR_EXTRA_BUF_SUPPORT
	bool "use Extra PVR Buffer to optimize the recording"
	depends on HI_PVR_SUPPORT
	help
	     With this option selected, 2*u32DavbufSize more memory will be allocated to buffer ts data by PVR,instead of saving data directly without 
	     buffering.Buffering ts data would  promote recording performance and avoid HI_UNF_EVENT_REC_DISK_SLOW event.
	default n
endmenu
```

## scripts/kconfig/Kconfig.rootbox
```kconfig
#---------------------------------------------

menu "File System Config"

config HI_ROOTFS_RULEFILE
	bool "Enable rulefile support"
	default n
	help
	  If you enable this option, rootfsimage-make tools will get rule-attr from a .txt file 
	  named "rulelist.txt". You should configure this .txt file when you want to use this function.

config  HI_ROOTFS_STRIP
	bool "Enable Strip"
	default y
	help
	  Whether strip the root filesystem.
	  If you select strip option, you will get fail when use gdb, because the clib is striped.
	       y - strip /bin /lib /sbin /usr
	       n - not strip

config  HI_ROOTFS_INSTALL_SHARED_LIBS
	bool "Install Share Libs to Rootbox"
	default y

config  HI_ROOTFS_CRAMFS
	bool "Create Cramfs Rootbox Image"
	default y

config  HI_ROOTFS_JFFS2
	bool "Create Jffs2 Rootbox Image"
	depends on HI_SPI_SUPPORT
	default y

config  HI_ROOTFS_YAFFS
	bool "Create Yaffs Rootbox Image"
	depends on HI_NAND_SUPPORT 
	default y

config  HI_ROOTFS_SQUASHFS
	bool "Create Squashfs Rootbox Image"
	default y

config  HI_ROOTFS_EXT2_EXT3
	bool "Create Ext2&Ext3 Rootbox Image"
	depends on HI_EMMC_SUPPORT
	default n

config  HI_EMMC_ROOTFS_SIZE
	string "eMMC Rootfs Size"
	depends on HI_ROOTFS_EXT2_EXT3
	default "40960-40M"
	help
	  eMMC rootfs size, unit is M.

config HI_ROOTFS_UBIIMG
	bool "Create Ubi Rootbox Image"
	depends on HI_NAND_SUPPORT
	default y

config HI_UBI_PARTITION_SIZE
	string "UBI Rootfs Size"
	depends on HI_ROOTFS_UBIIMG
	default "96M"

endmenu
#+++++++++++++++++++++++++++++++++++++++++++++++++++
```

## scripts/kconfig/Kconfig.rootfs
```kconfig
#+++++++++++++++++++++++++++++++++++++++++++++++++++
menu "Board Tools Config"
config  HI_TOOL_UDEV_SUPPORT
	bool "Udev Tools Support"
	default y
config  HI_TOOL_MDEV_SUPPORT
	bool "Mdev Tools Support"
	default n 
menuconfig  HI_TOOL_DOSFS_SUPPORT
	bool "Dosfs Tools Support"
	default n
config  HI_MKDOSFS_TOOLS_SUPPORT
	bool "Make Dosfs Tool Support"
	depends on HI_TOOL_DOSFS_SUPPORT
	default y
config  HI_DOSFSCK_TOOLS_SUPPORT
	bool "Check Dosfs Tool Support"
	depends on HI_TOOL_DOSFS_SUPPORT
	default y
config  HI_TOOL_E2FSPROGS_SUPPORT
	bool "Ext2/Ext3 Tools Support"
	depends on (!HI3716MV310)&&(!HI3716MV330)
	default n
config  HI_TOOL_FILECAP_SUPPORT
	bool "Filecap Tools Support"
	default n
	help
	  Filecap is used to change permission of files/dirs.
	  Only for CA user, if don't use CA, say n here.
config  HI_TOOL_GDB_SUPPORT
	bool "GDB/GDBServer Tools Support"
	default n
config  HI_TOOL_IPTABLES_SUPPORT
	bool "Iptables Tools Support"
	default n
config  HI_TOOL_MTDUTILS_SUPPORT
	bool "Mtdutils Tools Support"
	default n
config  HI_TOOL_REG_SUPPORT
	bool "Read/Write Registers Tools Support"
	default y
config  HI_TOOL_SANDBOX_SUPPORT
	bool "Sandbox Tool Support"
	default y
	depends on HI_ADVCA_SANDBOX_SUPPORT
	help
	  This tools is used only for CA, if no CA,say n here.
config  HI_TOOL_TOP_SUPPORT
	bool "Standard Top Tools Support"
	default n
config  HI_TOOL_PPPD_SUPPORT
	bool "PPPD Tool Support"
	default n
config  HI_TOOL_IPERF_SUPPORT
	bool "Iperf Support"
	default n
config  HI_TOOL_MSP_DEBUG_SUPPORT
	bool "Msp Debug Tool Support"
	default n
config  HI_TOOL_SOC_SERVER
	bool "SOC Server Tool Support"
	default n
config  HI_LXC_CONTAINER_SUPPORT
	bool "LXC Container Tools Support"
	default n
config  HI_TOOL_MEMTESTER_SUPPORT
	bool "Memtester Tool Support"
	default n
endmenu
#---------------------------------------------
menu "Busybox Config"
choice
	prompt "Busybox Version"
	default BUSYBOX_1.16.1 if (ARM_HISIV200_LINUX)
	default BUSYBOX_1.26.2 if (ARM_HISTBV310_LINUX)
config  BUSYBOX_1.16.1
	bool "busybox-1.16.1"
	depends on ARM_HISIV200_LINUX
config  BUSYBOX_1.26.2
	bool "busybox-1.26.2"
endchoice

config  HI_BUSYBOX_CFG_NAME
	string "Busybox Config File For Root" 
	default glibc.config      if ARM_HISIV200_LINUX
	default glibc.config      if ARM_HISTBV310_LINUX
	help
	  Input config file for root busybox. Such as xxxxx.config.
	  Config files are located in busybox source: busybox-1.*.1.config/

config  HI_BUSYBOX_CFG_SANDBOX_NAME
	string "Busybox Config File For Sandbox User" 
	default glibc_ca_sandbox.config      if ARM_HISIV200_LINUX
	default glibc_ca_sandbox.config      if ARM_HISTBV310_LINUX
	depends on HI_ADVCA_SANDBOX_SUPPORT
	help
	  Input config file for sandbox user busybox. Such as xxxxx.config.
	  Config files are located in busybox source: busybox-1.*.1.config/

endmenu

choice  HI_LIBC_SUPPORT
	bool "C Runtime Libarary Config"
	default HI_LIBC_LITE_SUPPORT
config  HI_LIBC_FULL_SUPPORT
	bool "C Runtime Libarary Full Support"
	help
	  If you need full C libarary support, say y here.
config  HI_LIBC_LITE_SUPPORT
	bool "C Runtime Libarary Lite Support"
	help
	  If you need lite C libarary support, say y here.This can save flash
	  size.
endchoice
config  HI_LIBCPP_SUPPORT
	bool "C++ Runtime Libarary Support"
	default y
	help
	  If you need use C++ libarary, say y here.

#---------------------------------------------
#+++++++++++++++++++++++++++++++++++++++++++++++++++
```

## scripts/kconfig/Kconfig.sci
```kconfig
#+++++++++++++++++++++++++++++++++++++
#menu "SCI support config"
#+++++++++++++++++++++++++++++++++++++

config HI_SCI_SUPPORT
	bool "SCI Support"
	default y

#+++++++++++++++++++++++++++++++++++++
#endmenu
#+++++++++++++++++++++++++++++++++++++
```
