## scripts/kconfig/Kconfig.bootloader
```kconfig
menuconfig HI_LOADER_BOOTLOADER
	bool "BootLoader Config"
	depends on HI_BOOTLOADER_SUPPORT
	default y

#------------------------------------------------
config  HI_DOUBLE_BOOTLOADER
	bool "Double bootloader"
	depends on HI_LOADER_BOOTLOADER
	default n
#------------------------------------------------

choice
    prompt "OSD Language Type"
    default HI_BOOTLOADER_OSD_LANG_EN
    depends on HI_LOADER_BOOTLOADER
config  HI_BOOTLOADER_OSD_LANG_EN
    bool "English"
config  HI_BOOTLOADER_OSD_LANG_CN
    bool "Chinese"
endchoice
#------------------------------------------------
config  HI_BOOTLOADER_MODE_USB
	bool "USB Upgrade Support"
	depends on HI_LOADER_BOOTLOADER
	default y
#	select HI_BOOT_USB_SUPPORT   #### for vmx bootloader

#------------------------------------------------
choice
        prompt "Protocol Type"
        default HI_BOOTLOADER_USB_PROTOCOL_HISI_FILE
        depends on HI_LOADER_BOOTLOADER

config  HI_BOOTLOADER_USB_PROTOCOL_HISI_FILE
        bool "Hisi File Protocol"
endchoice

#------------------------------------------------
config  HI_BOOTLOADER_MODE_OTA
	bool "OTA Upgrade Support"
	depends on HI_LOADER_BOOTLOADER
	default y
	select HI_BUILD_WITH_FRONTEND
	select HI_BUILD_WITH_DEMUX

#------------------------------------------------
choice
	prompt "Tuner Type"
	default HI_BOOTLOADER_TUNER_CAB
	depends on HI_BOOTLOADER_MODE_OTA

config  HI_BOOTLOADER_TUNER_CAB
	bool "Cable"

config  HI_BOOTLOADER_TUNER_TER
	bool "Terrestrial"

config  HI_BOOTLOADER_TUNER_SAT
	bool "Satellite"
config  HI_BOOTLOADER_TUNER_DVB_T
    bool "Terrestrial DVB_T"
config  HI_BOOTLOADER_TUNER_DVB_T2
    bool "Terrestrial DVB_T2"
endchoice

#------------------------------------------------
choice
	prompt "Protocol Type"
	default HI_BOOTLOADER_PROTOCOL_HISI_OTA
	depends on HI_BOOTLOADER_MODE_OTA

config  HI_BOOTLOADER_PROTOCOL_SSU_OTA
	bool "SSU Protocol"

config  HI_BOOTLOADER_PROTOCOL_HISI_OTA
	bool "Hisi OTA Protocol"
endchoice
```

## scripts/kconfig/Kconfig.ci
```kconfig
#+++++++++++++++++++++++++++++++++++++++++++++++++++
menu "CI/CI+ Config"
#--------------------------------

config HI_CIPLUS_SUPPORT
	bool "CI/CI+ Support"
	default n
	
config  HI_CI_DEV_CIMAX
	bool "CIMAX"
	depends on HI_CIPLUS_SUPPORT
	default y

config  HI_CI_DEV_CIMAXPLUS
	bool "CIMAXPLUS"
	depends on HI_CIPLUS_SUPPORT
	default n

config  HI_CI_DEV_HICI
	bool "HICI"
	depends on HI_CIPLUS_SUPPORT
	default n

#--------------------------------
endmenu
#+++++++++++++++++++++++++++++++++++++++++++++++++++
```

## scripts/kconfig/Kconfig.cipher
```kconfig
#+++++++++++++++++++++++++++++++++++++
menu "Cipher Config"
#+++++++++++++++++++++++++++++++++++++

menuconfig HI_CIPHER_MULTICIPHER_SUPPORT
	bool "Multicipher Support"
	default n

config  HI_CIPHER_MULTI_PACKGET
	bool "Support multi packet"
	depends on HI_CIPHER_MULTICIPHER_SUPPORT
	default n
	
menuconfig  HI_CIPHER_HASH_SUPPORT
	bool "Hash Support"
	default y

config  HI_CIPHER_AES_CBCMAC
	bool "Support AES CMAC"
	depends on HI_CIPHER_HASH_SUPPORT
	default n
	
config  HI_CIPHER_HASH_IRDETO_CBCMAC
	bool "Support Irdeto CMAC"
	depends on HI_CIPHER_HASH_SUPPORT
	default n
	
config  HI_CIPHER_HASH_HMAC
	bool "Support HMAC"
	depends on HI_CIPHER_HASH_SUPPORT
	default n
	
config HI_CIPHER_HDCP_SUPPORT
	bool "Hdcp Support"
	depends on !HI3110EV500
	select HI_CIPHER_MULTICIPHER_SUPPORT
	default y

config HI_CIPHER_RNG_SUPPORT
	bool "Rng Support"
	default y

#+++++++++++++++++++++++++++++++++++++
endmenu
#+++++++++++++++++++++++++++++++++++++
```

## scripts/kconfig/Kconfig.common
```kconfig
###############################################################################
config HI_LOG_SUPPORT
	bool "Log Support"
	depends on HI_ADVCA_FUNCTION!=FINAL && HI_ADVCA_FUNCTION!=RELEASE
	default y
	---help---
		If you want to close SDK print, say n.

##############################################################################
config HI_LOG_LEVEL
	int "Compile Log Level (0,4)"
	range 0 4
	default 1
	depends on HI_LOG_SUPPORT
	---help---
		This option control each CBB compile log level, range from 0 to 4. 
		0-the fatal level
		1-the error level
		2-the warning level
		3-the info level
		4-the debug level
		Default 1.
		NOTICE: This value only control the compiling log level of every module, the default output level is always 1(error).
		
##############################################################################
config HI_LOG_NETWORK_SUPPORT
	bool "Network Log Support"
	default n
	depends on HI_LOG_SUPPORT &&  HI_ETH_SUPPORT
	---help---
		This option control the network log output.
		If enable, supported network output. Default disable.
		
###############################################################################	
config HI_LOG_UDISK_SUPPORT
	bool "UDisk Log Support"
	default n
	depends on HI_LOG_SUPPORT
	---help---
		This option control the u-disk log. Default disable.
		If enble, the log will be written into u-disk.

###############################################################################	
config HI_MEMMGR_SUPPORT
	bool "Memory Manager Support"
	default n
	---help---
		This option control the memory statistical information. Default disable.
		
###############################################################################	
config HI_PROC_SUPPORT
	bool "Proc Support"
	depends on HI_ADVCA_FUNCTION!=FINAL && HI_ADVCA_FUNCTION!=RELEASE
	default y
	---help---
		If you want to get an advance CA release build, say no. Default enable.
		
###############################################################################	
config HI_MOD_POSTPID
	bool "Module Name Postfix PID"
	default n
	---help---
		This value control the module name has postfix PID or not.
###############################################################################
```

## scripts/kconfig/Kconfig.demux
```kconfig
#+++++++++++++++++++++++++++++++++++++++++++++++++++
menu "DEMUX Config"
config  HI_DEMUX_SUPPORT_PROC
	bool "Demux Proc Support"
	depends on HI_PROC_SUPPORT
	help 
	  If you want to enable show demux inner debug info, say y.
	default y

config  HI_DEMUX_SUPPORT_REC
	bool "Demux Rec Support"
	help 
	  If you want to support pvr, say y.
	default y
config  HI_DEMUX_SUPPORT_SCD
	bool "Demux Scd Support"
	depends on HI_DEMUX_SUPPORT_REC
	default y

config  HI_DEMUX_SUPPORT_TSO
	bool "Demux TSO Support"
	help 
	  If you want to support tso port, say y.
	default y

config	HI_DEMUX_SUPPORT_DESC
	bool "Desc Support"
	help
	  If you want to enable Desc, say y.
	default n 
	
config HI_DEMUX_POOLBUF_SIZE
	hex "DEMUX Poolbuf Size"
	default 0x200000
	help
	    Configure section, pes and post channel memory.

endmenu
#+++++++++++++++++++++++++++++++++++++++++++++++++++
```

## scripts/kconfig/Kconfig.env.media
```kconfig
choice
	prompt "Media Type"
	depends on HI_FORCE_ENV_TO_MEDIA
	default n

config FORCE_ENV_IN_NAND
	bool "Nand"
config FORCE_ENV_IN_SPI
	bool "SPI_Flash"
config FORCE_ENV_IN_EMMC
	bool "eMMC"
	depends on (!HI3716MV310)
endchoice
```

## scripts/kconfig/Kconfig.flash
```kconfig
#+++++++++++++++++++++++++++++++++++++++++++++++++++
menu "Flash Config"
#--------------------------------
menuconfig HI_NAND_SUPPORT
	bool "Nand Flash Support"
	default y
	help

config  HI_NAND_BLOCK_SIZE
	hex "Block Size"
	depends on HI_NAND_SUPPORT
	default 0x20000
	help
	  Nand flash block size if you have nand.
	
config  HI_NAND_PAGE_SIZE
	string "Page Size"
	depends on HI_NAND_SUPPORT
	default 2k
	help
	  Nand flash page size, such as 2k,4k,8k.

config  HI_NAND_ECC_TYPE
	string "ECC Type"
	depends on HI_NAND_SUPPORT
	default 1bit
	help
	  Nand flash chip ECC type, such as 1bit,4bit,8bit,24bit,40bit.
	
#--------------------------------
menuconfig HI_SPI_SUPPORT
	bool "SPI Flash Support"
	default y
	help

config  HI_SPI_BLOCK_SIZE
	hex "Block Size"
	depends on HI_SPI_SUPPORT
	default 0x10000
	help
	  SPI flash block size.
#+++++++++++++++++++++++++++++++++++++++++++++++++++
endmenu
```

## scripts/kconfig/Kconfig.frontend
```kconfig
#+++++++++++++++++++++++++++++++++++++++++++++++++++

menu "Frontend Config"

#--------------------------------
config HI_DISEQC_SUPPORT
	bool "DISEQC Support"
	default n
	help
#--------------------------------
menu "Tuner Config"

config  HI_TUNER_TYPE_XG_3BL
	bool "XG_3BL Support"
	default y

config  HI_TUNER_TYPE_CD1616
	bool "CD1616 Support"
	default y

config  HI_TUNER_TYPE_ALPS_TDAE
	bool "ALPS_TDAE Support"
	default y

config  HI_TUNER_TYPE_TDCC
	bool "TDCC Support"
	default y

config  HI_TUNER_TYPE_TDA18250
	bool "TDA18250 Support"
	default y

config  HI_TUNER_TYPE_TDA18250B
	bool "TDA18250B Support"
	default y

config  HI_TUNER_TYPE_CD1616_LF_GIH_4
	bool "CD1616_LF_GIH_4 Support"
	default y
	
config  HI_TUNER_TYPE_MT2081
	bool "MT2081 Support"
	default y
	
config  HI_TUNER_TYPE_TMX7070X
	bool "TMX7070X Support"
	default y
	
config  HI_TUNER_TYPE_R820C
	bool "R820C Support"
	default y

config  HI_TUNER_TYPE_R836
	bool "R836 Support"
	default y
			
config  HI_TUNER_TYPE_MXL203
	bool "MXL203 Support"
	default y

config  HI_TUNER_TYPE_AV2011
	bool "AV2011 Support"
	default y

config  HI_TUNER_TYPE_SHARP7903
	bool "SHARP7903 Support"
	default y

config  HI_TUNER_TYPE_M88TS2022
	bool "M88TS2022 Support"
	default y

config  HI_TUNER_TYPE_RDA5815
	bool "RDA5815 Support"
	default y

config  HI_TUNER_TYPE_MXL603
	bool "MXL603 Support"
	default y

config  HI_TUNER_TYPE_MXL608
        bool "MXL608 Support"
        default n

config  HI_TUNER_TYPE_TDA6651
	bool "TDA6651 Support"
	default y

config  HI_TUNER_TYPE_MXL214
	bool "MXL214 Support"
	default y
	
config  HI_TUNER_TYPE_MXL254
	bool "MXL254 Support"
	default y
	
config  HI_TUNER_TYPE_TDA18280
	bool "TDA18280 Support"
	default n
	
config  HI_TUNER_TYPE_TDA18215
	bool "TDA18215 Support"
	default n
	
config  HI_TUNER_TYPE_M88TC3800
	bool "M88TC3800 Support"
	default n

config  HI_TUNER_TYPE_SI2144
	bool "SI2144 Support"
	default n
	
config  HI_TUNER_TYPE_TDA18275A
	bool "TDA18275A Support"
	default n
	
config  HI_TUNER_TYPE_MXL661
	bool "MXL661 Support"
	default n	
	
config  HI_TUNER_TYPE_SI2150
	bool "SI2150 Support"
	default n	
		
config  HI_TUNER_TYPE_R850
	bool "R850 Support"
	default n
	
endmenu

#--------------------------------
menu "Demod Config"

config  HI_DEMOD_TYPE_HI3130I
	bool "HI3130I Support"
	default y

config  HI_DEMOD_TYPE_HI3130E
	bool "HI3130E Support"
	default y

config  HI_DEMOD_TYPE_J83B
	bool "J83B Support"
	depends on !HI3716MV330
	default y

config  HI_DEMOD_TYPE_AVL6211
	bool "AVL6211 Support"
	default y

config  HI_DEMOD_TYPE_MXL101
	bool "MXL101 Support"
	default y

config  HI_DEMOD_TYPE_MN88472
	bool "MN88472 Support"
	default y

config  HI_DEMOD_TYPE_IT9133
	bool "IT9133 Support"
	depends on !HI_DEMOD_TYPE_IT9170
	default y
	help
	  NOTE: IT9133 and IT9170 can't be selected together.

config  HI_DEMOD_TYPE_IT9170
	bool "IT9170 Support"
	default n
	help
	  NOTE: IT9133 and IT9170 can't be selected together.
	
config  HI_DEMOD_TYPE_HI3136
	bool "HI3136 Support"
	default y

config  HI_DEMOD_TYPE_HI3137
	bool "HI3137 Support"
	select HI_GPIOI2C_SUPPORT
	default y
	
config  HI_DEMOD_TYPE_MXL214
	bool "MXL214 Support"
	select HI_GPIOI2C_SUPPORT
	default y
	
config  HI_DEMOD_TYPE_MXL254
	bool "MXL254 Support"
	select HI_GPIOI2C_SUPPORT
	default y
	
config  HI_DEMOD_TYPE_TDA18280
	bool "TDA18280 Support"
	select HI_GPIOI2C_SUPPORT
	default n
	
config  HI_DEMOD_TYPE_HI3138
	bool "HI3138 Support"
	select HI_GPIOI2C_SUPPORT
	default y

config  HI_DEMOD_TYPE_ATBM8869
	bool "ATBM8869 Support"
	select HI_GPIOI2C_SUPPORT
	default n
	
endmenu

menu "LNB Chip Config"
config  HI_LNB_CTRL_ISL9492
         bool "ISL9492 Support"
         default y

config  HI_LNB_CTRL_MPS8125
         bool "MPS8125 Support"
         default n
endmenu

endmenu
#--------------------------------
#+++++++++++++++++++++++++++++++++++++++++++++++++++
```

## scripts/kconfig/Kconfig.graph
```kconfig
#+++++++++++++++++++++++++++++++++++++++++++++++++++
menu "Graphic Config"

choice
    prompt "jpeg version"
    default LIB_JPEG_VERSION_6B

config  LIB_JPEG_VERSION_6B
    bool "libjpeg-6b"
config  LIB_JPEG_VERSION_NEWEST
    bool "libjpeg"
endchoice

choice
    prompt "png version"
    default LIB_PNG_VERSION_1_4_16

config  LIB_PNG_VERSION_1_6_25
    bool "libpng-1.6.25"
config  LIB_PNG_VERSION_1_4_16
    bool "libpng-1.4.16"
endchoice

config HI_JPEG_SOFT_ENCODE_SUPPORT
    bool "jpeg soft encode support"
    default n

menuconfig HI_DIRECTFB_SUPPORT
    bool "DirectFB Support"
    default n

choice
    prompt "DirectFB Version"
    default HI_DIRECTFB_1_4_2
    depends on HI_DIRECTFB_SUPPORT

config HI_DIRECTFB_1_4_2
    bool "DirectFB-1.4.2"
    
endchoice

config HI_DIRECTFB_MULTI_SUPPORT
    bool "DirectFB Multi Process support"
    default n
    depends on HI_DIRECTFB_SUPPORT

config HI_DIRECTFB_DEBUG_SUPPORT
    bool "DirectFB Debug support"
    default n
    depends on HI_DIRECTFB_SUPPORT

config HI_DIRECTFB_CA_SUPPORT
    bool "DirectFB Ca Support"
    default n
    depends on HI_DIRECTFB_SUPPORT && HI_ADVCA_SUPPORT

config  HIFB_CURSOR_SUPPORT
        bool "Cursor in FB Support"
        default n

config	HIFB_SCROLLTEXT_SUPPORT
	bool "Scrolltext in FB Support"
	default y
	
config	HI_PNG_DECODER_SUPPORT
	bool "Png Decoder Support"
	default n
		
config	HI_FREETYPE_FONT_SUPPORT
	bool "Freetype Font Support"
	default n	
	
config	HI_FREETYPE_MINI_LIB_SUPPORT
	depends on HI_FREETYPE_FONT_SUPPORT
	bool "Mini Freetype Lib"
	default n
		
config 	HI_TDE_CSCTMPBUFFER_SIZE
	hex "TDE Temporary Buffer Size"
        default 0x0
	help
	  Regard to low quality, the size is 0. 
	  Regard to middle quality, the size is (input width * input height * 2).
	  Regard to high quality, the size is(output width * output height * 3).
	  This Buffer Used to YUV Semi-planar to YUV Package 422 or ARGB Conversion.

config 	HI_JPEG6B_STREAMBUFFER_SIZE
	hex "JPEG Stream Buffer Size"
        default 0x80000

config 	HI_HD_FB_VRAM_SIZE
	depends on HI3716MV310 || HI3716MV320 || HI3716MV330
	int "KB, HD FrameBuffer Size"
	default 7368  if HI3716MV310 || HI3716MV320 || HI3716MV330
        help
          For 1280*720, triple buffer, ARGB8888 format, the size is calculated as below:
          (1280*720*4*2/1024)KB
        
config 	HI_SD_FB_VRAM_SIZE
	depends on HI3110EV500
	int "KB, SD FrameBuffer Size"
	default 3600
        help
          For 720*576, triple buffer, ARGB1555 format, the size is calculated as below:
          (720*576*2*2/1024)KB      
        
config 	HI_AD0_FB_VRAM_SIZE
	depends on HIFB_SCROLLTEXT_SUPPORT || HIFB_CURSOR_SUPPORT
	int "KB, AD0 FrameBuffer Size"
	default 400
	help
          For 1280*80, double buffer, ARGB8888 format, the size is calculated as below:
          (1280*80*2*2/1024)KB
          
endmenu
#+++++++++++++++++++++++++++++++++++++++++++++++++++
```
