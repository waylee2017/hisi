## scripts/kconfig/Kconfig.hacodec
```kconfig
#++++++++++++++++++++++++++++++++++++++++++++++++++++
menu "HACODEC Config"
#--------------------------------
config HI_HACODEC_MP3DECODE_SUPPORT
	bool "HACODEC MP3 Decode Support"
	default y
	
config HI_HACODEC_AACDECODE_SUPPORT
	bool "HACODEC AAC Decode Support"
	default y
	
config HI_HACODEC_AC3PASSTHROUGH_SUPPORT
	bool "HACODEC AC3 Passthrough Support"
	default y
	
config HI_HACODEC_AMRNBCODEC_SUPPORT
	bool "HACODEC AMRNB Codec Support"
	default y
	
config HI_HACODEC_AMRWBCODEC_SUPPORT
	bool "HACODEC AMRWB Codec Support"
	default y
	
config HI_HACODEC_BLURAYLPCMDECODE_SUPPORT
	bool "HACODEC BLURAYLPCM Decode Support"
	default y
	
config HI_HACODEC_COOKDECODE_SUPPORT
	bool "HACODEC COOK Decode Support"
	default y
	
config HI_HACODEC_DRADECODE_SUPPORT
	bool "HACODEC DRA Decode Support"
	default y
	
config HI_HACODEC_DTSPASSTHROUGH_SUPPORT
	bool "HACODEC DTS Passthrough Support"
	default y
	
config HI_HACODEC_G711CODEC_SUPPORT
	bool "HACODEC G711 Codec Support"
	default y
	
config HI_HACODEC_G722CODEC_SUPPORT
	bool "HACODEC G722 Codec Support"
	default y
	
config HI_HACODEC_MP2DECODE_SUPPORT
	bool "HACODEC MP2 Decode Support"
	default y
	
config HI_HACODEC_PCMDECODE_SUPPORT
	bool "HACODEC PCM Decode Support"
	default y
	
	
config HI_HACODEC_WMADECODE_SUPPORT
	bool "HACODEC WMA Decode Support"
	default y													
#--------------------------------
endmenu
#++++++++++++++++++++++++++++++++++++++++++++++++++++
```

## scripts/kconfig/Kconfig.hdmi
```kconfig
#+++++++++++++++++++++++++++++++++++++++++++++++++++
menu "HDMI Config"
config	HI_HDMI_SUPPORT_DVI
	bool "DVI Support"
	depends on HI_DISP_LCD_SUPPORT
	help
	  If you want to enable DVI, say y.
	default n 

config	HI_HDMI_SUPPORT_HDCP
	bool "HDCP Support"
	help
	  If you want to enable HDCP, say y. 
	default n 

config	HI_HDMI_SUPPORT_CEC
	bool "CEC Support"
	help
	  If you want to enable CEC, say y.
	default n

config  HI_HDMI_SUPPORT_DEBUG
	bool "DEBUG Support"
	help
		If you want to enable debug, say y.
	default n   

config  HI_HDMI_DEBUG_MEM_SIZE
	depends on HI_HDMI_SUPPORT_DEBUG
	hex "DEBUG Memory Size (BYTE)"
	help
		If you want to enable debug, say y.
	default 0x80000

endmenu
#+++++++++++++++++++++++++++++++++++++++++++++++++++
```
