## scripts/kconfig/Kconfig.advca
```kconfig
#+++++++++++++++++++++++++++++++++++++++++++++++++++
menuconfig HI_ADVCA_SUPPORT
	bool "Advance CA Support"
	default n
#--------------------------------
choice
	prompt "Advance CA Type"
	depends on HI_ADVCA_SUPPORT
	default ADVCA_OTHER
config  ADVCA_CONAX
	bool "Conax"
config  ADVCA_NOVEL
	bool "Novel"
config  ADVCA_NAGRA
	bool "Nagra"
config  ADVCA_SUMA
	bool "Suma"
config  ADVCA_CTI
	bool "Cti"
config  ADVCA_VERIMATRIX
	bool "Verimatrix"
config  ADVCA_IRDETO
	bool "Irdeto"
config  ADVCA_PANACCESS
	bool "Panaccess"
config  ADVCA_DCAS
	bool "Dcas"
config  ADVCA_OTHER
	bool "Other"
endchoice

config  HI_ADVCA_TYPE
	string
	depends on HI_ADVCA_SUPPORT
	default CONAX           if ADVCA_CONAX
	default NOVEL           if ADVCA_NOVEL
	default NAGRA           if ADVCA_NAGRA
	default SUMA            if ADVCA_SUMA
	default CTI             if ADVCA_CTI
	default VERIMATRIX      if ADVCA_VERIMATRIX
	default IRDETO		if ADVCA_IRDETO
	default PANACCESS	if ADVCA_PANACCESS
	default DCAS		if ADVCA_DCAS
	default OTHER           if ADVCA_OTHER
#--------------------------------


menuconfig ADVCA_FUNCTION
	bool "Advance CA Function"
	depends on HI_ADVCA_SUPPORT && (ADVCA_CONAX || ADVCA_NAGRA)
	default n
	help
	  From now on,this option is only for Nagra and Conax CA.Some functions of SDK are disabled,especially those for debugging.

choice
	prompt "Advca Function"
	depends on ADVCA_FUNCTION
config  FUNCTION_FINAL
	bool "FINAL"
	select HI_ADVCA_SANDBOX_SUPPORT if !HI_LOADER_APPLOADER
	help
	  With this option selected,SDK can meets some security requirements of advanced CA listed below.
	  1.Useless drivers,modules and libraries are not allowed to be compiled.
	  2.Modules in kernel are not unloadable.
	  3.NFS is not supported.
	  4.No debugging method is supported.No debugging information outputs.
	  5.No user can log into system through shell.
config  FUNCTION_RELEASE
	bool "RELEASE"
	select HI_ADVCA_SANDBOX_SUPPORT if !HI_LOADER_APPLOADER
	help
	  With this option selected,functions below are added to FINAL version.
	  1.Allow communication through UART.
	  2.Allow user to log into system.
	  3.Allow user to run apps in command line.
config  FUNCTION_DEBUG
	bool "DEBUG"
	select HI_ADVCA_SANDBOX_SUPPORT if !HI_LOADER_APPLOADER
	help
	  With this option selected,functions below are added to RELEASE version.
	  1.NFS and telenet service are supported.
	  2.Printf and printk are allowed to output information.
	  3.Himd and himm can be used to check and modify data in RAM.
	  4.All commands in busybox are provided.
	  5.System information can be gotten through proc file system.
endchoice

config  HI_ADVCA_FUNCTION
	string
	depends on ADVCA_FUNCTION
	default DEBUG       if FUNCTION_DEBUG
	default RELEASE     if FUNCTION_RELEASE
	default FINAL       if FUNCTION_FINAL

config HI_STATIC_LIB_ONLY
	bool
	default y
	depends on ADVCA_FUNCTION

config HI_ADVCA_VERIFY_ENABLE
	bool "Advca verify enable"
	depends on HI_ADVCA_SUPPORT
	help
	  If you want to enable boot to verify other images (kernel,loader,rootfs and so on), say y.

config HI_ADVCA_VMX_3RD_SIGN
    bool "Verimatrix Third-Party Sign Solution"
    depends on (HI_ADVCA_SUPPORT && ADVCA_VERIMATRIX)
	default n
    help
      If you want to enable verimatrix third-party signing solution, say y.

config HI_ADVCA_USE_EXT1_RSA_KEY
	bool "Verify with ext1_rsa_key"
	depends on HI_ADVCA_SUPPORT && ADVCA_CONAX
	default n
	help
	  If the boot verify other images (kernel,loader,rootfs and so on) with the ext1_rsa_key which is stored in the key area of signed boot image, say y.
	  If this option is not selected, the boot will verify other images with the ext2_rsa_key in bootcode.
	  Please refer to source/boot/product/driver/advca/common/auth/ca_config.c for ext2_rsa_key.
#--------------------------------
menuconfig HI_ADVCA_SANDBOX_SUPPORT
	bool "Support Advance CA Sandbox"
	depends on HI_ADVCA_SUPPORT
	default y
	
choice
	prompt "CA Sandbox Type"
	depends on HI_ADVCA_SANDBOX_SUPPORT
	default SANDBOX_CHROOT
config  SANDBOX_CHROOT
	bool "Chroot"
	select HI_TOOL_SANDBOX_SUPPORT
config  SANDBOX_LXC
	bool "LXC"
	select HI_LXC_CONTAINER_SUPPORT

endchoice

config  HI_ADVCA_SANDBOX_TYPE
	string
	depends on HI_ADVCA_SANDBOX_SUPPORT
	default CHROOT        if SANDBOX_CHROOT
	default LXC           if SANDBOX_LXC

#--------------------------------
```

## scripts/kconfig/Kconfig.alsa
```kconfig
config HI_ALSA_SUPPORT
	bool "ALSA Support"
	depends on !HI_BLUETOOTH_SUPPORT
	default n
```

## scripts/kconfig/Kconfig.apploader
```kconfig
menuconfig HI_LOADER_APPLOADER
	bool "AppLoader Config"
	depends on HI_APPLOADER_SUPPORT

#------------------------------------------------
choice
	prompt "OSD Language Type"
	default HI_APPLOADER_OSD_LANG_EN
	depends on HI_LOADER_APPLOADER

config  HI_APPLOADER_OSD_LANG_EN
	bool "English"

config  HI_APPLOADER_OSD_LANG_CN
	bool "Chinese"
endchoice

config  HI_APPLOADER_LOGOUT_DISABLE
        bool "Disable Log Output in Apploader"
	default n
	depends on HI_LOADER_APPLOADER

#------------------------------------------------        
config  HI_APPLOADER_INITRD_BASE_ADDR
    hex "Initrd filesystem base addr in mkbootimg tool"
    default 0x80900000
    depends on HI_LOADER_APPLOADER && ADVCA_CONAX
    help
    Initrd filesystem base addr in mkbootimg tool,if initrd=0x81900000 in bootargs,here need set it as 0x80900000
    As mkbootimg will add 0x1000000 kernel space before fs position.

#------------------------------------------------
config  HI_APPLOADER_MODE_USB
	bool "USB Upgrade Support"
	default y
	depends on HI_LOADER_APPLOADER

#------------------------------------------------
choice
        prompt "Protocol Type"
        default HI_APPLOADER_USB_PROTOCOL_HISI_FILE
        depends on HI_APPLOADER_MODE_USB

config  HI_APPLOADER_USB_PROTOCOL_HISI_FILE
        bool "Hisi File Protocol"
endchoice

#------------------------------------------------
config  HI_APPLOADER_MODE_IP
	bool "IP Upgrade Support"
	depends on HI_LOADER_APPLOADER && !HI_ADVCA_SUPPORT
	default y
	select HI_CURL_SUPPORT

#------------------------------------------------
choice
        prompt "Protocol Type"
        default HI_APPLOADER_IP_PROTOCOL_HISI_FILE
        depends on HI_APPLOADER_MODE_IP

config  HI_APPLOADER_IP_PROTOCOL_HISI_FILE
        bool "Hisi File Protocol"
endchoice

#------------------------------------------------
config  HI_APPLOADER_MODE_OTA
	bool "OTA Upgrade Support"
	default y
	depends on HI_LOADER_APPLOADER

#------------------------------------------------
choice
	prompt "Tuner Type"
	default HI_APPLOADER_TUNER_CAB
	depends on HI_APPLOADER_MODE_OTA

config  HI_APPLOADER_TUNER_CAB
	bool "Cable"
config  HI_APPLOADER_TUNER_SAT
	bool "Satellite"
config  HI_APPLOADER_TUNER_DVB_T
   	bool "Terrestrial DVB_T"
config  HI_APPLOADER_TUNER_DVB_T2
  	bool "Terrestrial DVB_T2"
endchoice

#------------------------------------------------
choice
	prompt "Protocol Type"
	default HI_APPLOADER_PROTOCOL_HISI_OTA
	depends on HI_APPLOADER_MODE_OTA

config  HI_APPLOADER_PROTOCOL_SSU_OTA
	bool "SSU Protocol"

config  HI_APPLOADER_PROTOCOL_HISI_OTA
	bool "Hisi OTA Protocol"
endchoice

#+++++++++++++++++++++++++++++++++++++++++++++++++++
```

## scripts/kconfig/Kconfig.audio
```kconfig
#++++++++++++++++++++++++++++++++++++++++++++++++++++
menu "Audio Config"
#--------------------------------
config	HI_SND_ALSA_AO_SUPPORT
	bool "AO ALSA Support"
	default n
config HI_SND_ADAC_SUPPORT
	bool "ADAC Support"
	default y
config HI_SND_SPDIF_SUPPORT
	bool "SPDIF Support"
	default y
config HI_SND_HDMI_SUPPORT
	bool "HDMI Support"
	depends on !HI3110EV500
	default y
config HI_ADEC_MAX_INSTANCE
	int "ADEC Max Instance Number(1~16)"
	range 1 16
	default 2
	help
		It is necessarily set to bigger than 1 to support mce-fastpaly.

config HI_ADEC_AUDSPECTRUM_SUPPORT
	bool "ADEC Audio Spectrum Support"
	default n

config HI_SND_AVC_SUPPORT
	bool "SND Auto Volume Control Support"
	default n 	
		
config HI_RESAMPLER_QUALITY_LINEAR
	bool "Linear Resampler"
	default y
config HI_SUPPORT_INTERNAL_OP
	bool "Internal op"
	default n
	help
		Use external OP if this option is not selected.
choice
	prompt "Internal OP Type"
	depends on HI_SUPPORT_INTERNAL_OP
	default MAX_GAIN		
	config  MAXGAINOUTPUT
	bool "MAX_GAIN"
    config  2VGAINOUTPUT
	bool "2V_GAIN"
endchoice
#--------------------------------
endmenu
#++++++++++++++++++++++++++++++++++++++++++++++++++++
```

## scripts/kconfig/Kconfig.avplay
```kconfig
#++++++++++++++++++++++++++++++++++++++++++++++++++++
menu "Avplay Config"
	depends on (HI3716MV310 || HI3716MV330)
#--------------------------------
config HI_AVPLAY_FCC_SUPPORT
        bool "FCC Support"
        default n

endmenu
#++++++++++++++++++++++++++++++++++++++++++++++++++++
```

## scripts/kconfig/Kconfig.base
```kconfig
  
###########################################################
choice
	prompt "Chip Type"
	default HI3716MV310
config  HI3716MV310
	bool "hi3716mv310"
config  HI3110EV500
	bool "hi3110ev500"
config  HI3716MV330
	bool "hi3716mv330"
endchoice

config  HI_CHIP_TYPE
	string 
	default hi3716mv310      if HI3716MV310
	default hi3110ev500      if HI3110EV500
	default hi3716mv330      if HI3716MV330

###########################################################
choice
	prompt "Toolchains Type"
	default ARM_HISTBV310_LINUX if HI3716MV330

config  ARM_HISIV200_LINUX
	bool "arm-hisiv200-linux"
config  ARM_HISTBV310_LINUX
	bool "arm-histbv310-linux"
endchoice

config  HI_TOOLCHAINS_NAME
	string 
	default arm-hisiv200-linux 	if ARM_HISIV200_LINUX
	default arm-histbv310-linux 	if ARM_HISTBV310_LINUX
	
###########################################################
menuconfig  HI_LOADER_SUPPORT
	bool "HiLoader Support"	
	default n

#------------------------------------------------
#menu	"HiLoader Config"
#	depends on HI_LOADER_SUPPORT
	
choice
	prompt "Support Loader Type"
	default HI_APPLOADER_SUPPORT
	depends on HI_LOADER_SUPPORT

config  HI_BOOTLOADER_SUPPORT
	bool "BootLoader"
	select HI_BUILD_WITH_PRODUCT

config  HI_APPLOADER_SUPPORT
	bool "AppLoader"
endchoice
	
###########################################################	
config HI_OPTM_SIZE_SUPPORT
	bool "Optimize For Size"
	default n
```

## scripts/kconfig/Kconfig.bluetooth
```kconfig
#+++++++++++++++++++++++++++++++++++++++++++++++++++
#--------------------------------
menuconfig HI_BLUETOOTH_SUPPORT
	bool "Bluetooth Support"
	default n
	help
	  ALSA will support too when support Bluetooth.

menu    "BlueTooth Device Type"
	depends on HI_BLUETOOTH_SUPPORT

config  HI_BLUETOOTH_DEVICE_RTL8723BU
	bool "Realtek RTL8723BU bluetooth driver"
endmenu
```

## scripts/kconfig/Kconfig.board
```kconfig
#+++++++++++++++++++++++++++++++++++++++++++++++++++
if !HI3110EV500 || HI_BOOT_USB2ETHER
source "scripts/kconfig/Kconfig.board.eth"
endif
source "scripts/kconfig/Kconfig.flash"
source "scripts/kconfig/Kconfig.board.tuner"
source "scripts/kconfig/Kconfig.board.videodac"
source "scripts/kconfig/Kconfig.keyled"
source "scripts/kconfig/Kconfig.board.mutectrl"
if HI_SCI_SUPPORT
source "scripts/kconfig/Kconfig.board.sci"
endif
source "scripts/kconfig/Kconfig.board.bootreg"
#+++++++++++++++++++++++++++++++++++++++++++++++++++

	
```

## scripts/kconfig/Kconfig.board.bootreg
```kconfig
#+++++++++++++++++++++++++++++++++++++++++++++++++++
config  HI_BOOT_REG_NAME
	prompt "Fastboot Reg File"
	string
	default hi3716mdmo3avera_hi3716mv300_ddr3_256mbyte_16bit_2layers.reg
config  HI_BOOT_CFG_NAME
	depends on HI_ADVCA_SUPPORT
	prompt "Fastboot CFG File for advca only"
	string
	default hi3716m31dmb_hi3716mv310_ddr3_512Mbyte_16bit_2layers_nand.cfg
#+++++++++++++++++++++++++++++++++++++++++++++++++++
```

## scripts/kconfig/Kconfig.board.eth
```kconfig
#+++++++++++++++++++++++++++++++++++++++++++++++++++
menu "Ethernet Config"
config  HI_ETH_SUPPORT
	bool "Ethernet Support"
	default y
	help
	  Support ethernet function enables you to use ethernet.
	  You should say y here, unless you really know what are 
	  you doing. Say no here can get a smaller fastboot.
config  HI_ETH_UP_PHYADDR
	int "Up Port Phyaddr (0, 31)"
	depends on HI_ETH_SUPPORT
	range 0 31
	default 1
config  HI_ETH_DOWN_PHYADDR
	int "Down Port Phyaddr(0, 31)"
	depends on HI_ETH_SUPPORT
	range 0 31
	default 3
endmenu
#+++++++++++++++++++++++++++++++++++++++++++++++++++
```

## scripts/kconfig/Kconfig.board.mutectrl
```kconfig
#+++++++++++++++++++++++++++++++++++++++++++++++++++
menuconfig HI_SND_MUTECTL_SUPPORT
	bool "Snd Mute Control Support"
	default n


config HI_SND_MUTECTL_GPIO
	hex  "Snd Mute Control Gpio"
	depends on HI_SND_MUTECTL_SUPPORT
	default 0x17
	help
	  Mute control gpio,hardware related setting.0x17 is for hisi demoB.
		        board_type            level	gpio_pin (gpio_pin = gpio_group * 8 + gpio_num)
		 BOARD_TYPE_hi3716MV330	 	0       0x17(GPIO2_7)


config HI_SND_MUTECTL_LEVEL
	int "Snd Mute Control Level (0, 1)"
	depends on HI_SND_MUTECTL_SUPPORT
	range 0 1
	default 0
	help
	  mute control gpio,hardware related setting.0 is for hisi demoB.
		        board_type            level	gpio_pin (gpio_pin = gpio_group * 8 + gpio_num)
		 BOARD_TYPE_hi3716MV330 	0       0x17(GPIO2_7)

#+++++++++++++++++++++++++++++++++++++++++++++++++++	
```

## scripts/kconfig/Kconfig.board.sci1
```kconfig
#+++++++++++++++++++++++++++++++++++++++++++++++++++
menu "Second Sci Config"

choice
	prompt "Clock Mode"
	help
	    HI_UNF_SCI_MODE_CMOS means CMOS output, HI_UNF_SCI_MODE_OD means OD output.
	default HI_SCI_CLK_MODE_CMOS

config  HI_SCI1_CLK_MODE_CMOS
	bool "CMOS"
config  HI_SCI1_CLK_MODE_OD
	bool "OD"
endchoice

choice
	depends on HI3716MV330
	prompt "VccEn Mode"
	help
	    HI_UNF_SCI_MODE_CMOS means CMOS output, HI_UNF_SCI_MODE_OD means OD output.
	default HI_SCI_VCCEN_MODE_CMOS

config  HI_SCI1_VCCEN_MODE_CMOS
	bool "CMOS"
config  HI_SCI1_VCCEN_MODE_OD
	bool "OD"
endchoice

choice
	depends on HI3716MV330
	prompt "Reset Mode"
	help
	    HI_UNF_SCI_MODE_CMOS means CMOS output, HI_UNF_SCI_MODE_OD means OD output.
	default HI_SCI_RESET_MODE_CMOS

config  HI_SCI1_RESET_MODE_CMOS
	bool "CMOS"
config  HI_SCI1_RESET_MODE_OD
	bool "OD"
endchoice

choice
	prompt "VccEn Pin Active Level"
	help
	    Low level active or high level active.
	default HI_SCI_VCCEN_LOW

config  HI_SCI1_VCCEN_LOW
	bool "Low Level"
config  HI_SCI1_VCCEN_HIGH
	bool "High Level"
endchoice

choice
	prompt "Detect Pin Active Level"
	help
	    Low level active or high level active.
	default HI_SCI_DETECT_LOW

config  HI_SCI1_DETECT_LOW
	bool "Low Level"
config  HI_SCI1_DETECT_HIGH
	bool "High Level"
endchoice

#+++++++++++++++++++++++++++++++++++++++++++++++++++
endmenu
#+++++++++++++++++++++++++++++++++++++++++++++++++++
```

## scripts/kconfig/Kconfig.board.tuner
```kconfig
#+++++++++++++++++++++++++++++++++++++++++++++++++++
menu "Tuner Config"

config HI_TUNER_NUMBER
        int "Tuner Number"
        default 1
        range 0 2
        help
          Configure the number of board tuner.

source "scripts/kconfig/Kconfig.board.tuner0"
source "scripts/kconfig/Kconfig.board.tuner1"

endmenu
#+++++++++++++++++++++++++++++++++++++++++++++++++++
```

## scripts/kconfig/Kconfig.board.videodac
```kconfig
#+++++++++++++++++++++++++++++++++++++++++++++++++++
menu "Video DAC Config"

config HI_DAC_CVBS
	int "CVBS"
	range 0 5
	help 
	    DAC number used as CVBS.
	default 3
	
config HI_DAC_YPBPR_Y
	int "YPBPR_Y"
	depends on !HI3110EV500
	range 0 5
	help 
	    DAC number used as YPBPR_Y.
	default 1
	
config HI_DAC_YPBPR_PB
	int "YPBPR_PB"
	depends on !HI3110EV500
	range 0 5
	help 
	    DAC number used as YPBPR_PB.
	default 0
	
config HI_DAC_YPBPR_PR
	int "YPBPR_PR"
	depends on !HI3110EV500
	range 0 5
	help 
	    DAC number used as YPBPR_PR.
	default 2
	 
endmenu	
#+++++++++++++++++++++++++++++++++++++++++++++++++++
```
